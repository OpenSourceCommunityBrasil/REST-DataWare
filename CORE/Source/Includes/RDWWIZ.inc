{$J+}
{$R-}
{$B-}
{$C+}
{$T-}

{$IFDEF LINUX}
{$DEFINE TMSCLX}
{$ENDIF}

{$IFDEF VER90}
{$DEFINE DELPHI2_LVL}
{$DEFINE ISDELPHI}
{$ENDIF}

{$IFDEF VER93}
{$DEFINE DELPHI2_LVL}
{$ENDIF}

{$IFDEF VER100}
{$DEFINE DELPHI2_LVL}
{$DEFINE DELPHI3_LVL}
{$DEFINE ISDELPHI}
{$ENDIF}

{$IFDEF VER110}
{$DEFINE DELPHI2_LVL}
{$DEFINE DELPHI3_LVL}
{$ENDIF}

{$IFDEF VER120}
{$DEFINE DELPHI2_LVL}
{$DEFINE DELPHI3_LVL}
{$DEFINE DELPHI4_LVL}
{$DEFINE ISDELPHI}
{$ENDIF}

{$IFDEF VER125}
{$DEFINE DELPHI2_LVL}
{$DEFINE DELPHI3_LVL}
{$DEFINE DELPHI4_LVL}
{$ENDIF}

{$IFDEF VER130}
{$DEFINE DELPHI2_LVL}
{$DEFINE DELPHI3_LVL}
{$DEFINE DELPHI4_LVL}
{$DEFINE DELPHI5_LVL}
{$ENDIF}

{$IFDEF VER140}
{$DEFINE DELPHI2_LVL}
{$DEFINE DELPHI3_LVL}
{$DEFINE DELPHI4_LVL}
{$DEFINE DELPHI5_LVL}
{$DEFINE DELPHI6_LVL}
 {$IFNDEF BCB}
  {$DEFINE ISDELPHI}
 {$ENDIF}
{$ENDIF}

{$IFDEF VER150}
{$DEFINE DELPHI2_LVL}
{$DEFINE DELPHI3_LVL}
{$DEFINE DELPHI4_LVL}
{$DEFINE DELPHI5_LVL}
{$DEFINE DELPHI6_LVL}
{$DEFINE DELPHI7_LVL}
 {$IFNDEF BCB}
  {$DEFINE ISDELPHI}
 {$ENDIF}
{$ENDIF}

{$IFDEF VER160}
  {$DEFINE DELPHI2_LVL}
  {$DEFINE DELPHI3_LVL}
  {$DEFINE DELPHI4_LVL}
  {$DEFINE DELPHI5_LVL}
  {$DEFINE DELPHI6_LVL}
  {$DEFINE DELPHI7_LVL}
  {$IFNDEF BCB}
    {$DEFINE ISDELPHI}
  {$ENDIF}
{$ENDIF}

{$IFDEF VER170}
  {$DEFINE DELPHI2_LVL}
  {$DEFINE DELPHI3_LVL}
  {$DEFINE DELPHI4_LVL}
  {$DEFINE DELPHI5_LVL}
  {$DEFINE DELPHI6_LVL}
  {$DEFINE DELPHI7_LVL}
  {$DEFINE DELPHI9_LVL}
  {$IFNDEF BCB}
    {$DEFINE ISDELPHI}
  {$ENDIF}
{$ENDIF}

{$IFDEF VER180}
  {$DEFINE DELPHI2_LVL}
  {$DEFINE DELPHI3_LVL}
  {$DEFINE DELPHI4_LVL}
  {$DEFINE DELPHI5_LVL}
  {$DEFINE DELPHI6_LVL}
  {$DEFINE DELPHI7_LVL}
  {$DEFINE DELPHI9_LVL}
  {$DEFINE DELPHI2006_LVL}
  {$IFNDEF BCB}
    {$DEFINE ISDELPHI}
  {$ENDIF}
{$ENDIF}

{$IFDEF VER185}
  {$DEFINE DELPHI2_LVL}
  {$DEFINE DELPHI3_LVL}
  {$DEFINE DELPHI4_LVL}
  {$DEFINE DELPHI5_LVL}
  {$DEFINE DELPHI6_LVL}
  {$DEFINE DELPHI7_LVL}
  {$DEFINE DELPHI9_LVL}
  {$DEFINE DELPHI2006_LVL}
  {$DEFINE DELPHI2007_LVL}
  {$IFNDEF BCB}
    {$DEFINE ISDELPHI}
  {$ENDIF}
{$ENDIF}

{$IFDEF VER190}
  {$DEFINE DELPHI2_LVL}
  {$DEFINE DELPHI3_LVL}
  {$DEFINE DELPHI4_LVL}
  {$DEFINE DELPHI5_LVL}
  {$DEFINE DELPHI6_LVL}
  {$DEFINE DELPHI7_LVL}
  {$DEFINE DELPHI9_LVL}
  {$DEFINE DELPHI2006_LVL}
  {$DEFINE DELPHI2007_LVL}
  {$IFNDEF BCB}
    {$DEFINE ISDELPHI}
  {$ENDIF}
{$ENDIF}

{$IFDEF VER200}
  {$DEFINE DELPHI2_LVL}
  {$DEFINE DELPHI3_LVL}
  {$DEFINE DELPHI4_LVL}
  {$DEFINE DELPHI5_LVL}
  {$DEFINE DELPHI6_LVL}
  {$DEFINE DELPHI7_LVL}
  {$DEFINE DELPHI9_LVL}
  {$DEFINE DELPHI2006_LVL}
  {$DEFINE DELPHI2007_LVL}
  {$DEFINE DELPHI_UNICODE}
  {$IFNDEF BCB}
    {$DEFINE ISDELPHI}
  {$ENDIF}
{$ENDIF}

{$IFDEF VER210}
  {$DEFINE DELPHI2_LVL}
  {$DEFINE DELPHI3_LVL}
  {$DEFINE DELPHI4_LVL}
  {$DEFINE DELPHI5_LVL}
  {$DEFINE DELPHI6_LVL}
  {$DEFINE DELPHI7_LVL}
  {$DEFINE DELPHI9_LVL}
  {$DEFINE DELPHI2006_LVL}
  {$DEFINE DELPHI2007_LVL}
  {$DEFINE DELPHI2010_LVL}
  {$DEFINE DELPHI_TOUCH}
  {$DEFINE DELPHI_UNICODE}
  {$IFNDEF BCB}
    {$DEFINE ISDELPHI}
  {$ENDIF}
{$ENDIF}

{$IFDEF VER220}
  {$DEFINE DELPHI2_LVL}
  {$DEFINE DELPHI3_LVL}
  {$DEFINE DELPHI4_LVL}
  {$DEFINE DELPHI5_LVL}
  {$DEFINE DELPHI6_LVL}
  {$DEFINE DELPHI7_LVL}
  {$DEFINE DELPHI9_LVL}
  {$DEFINE DELPHI2006_LVL}
  {$DEFINE DELPHI2007_LVL}
  {$DEFINE DELPHI2010_LVL}
  {$DEFINE DELPHIXE_LVL}
  {$DEFINE DELPHI_TOUCH}
  {$DEFINE DELPHI_UNICODE}
  {$IFNDEF BCB}
    {$DEFINE ISDELPHI}
  {$ENDIF}
{$ENDIF}

{$IFDEF VER230}
  {$DEFINE DELPHI2_LVL}
  {$DEFINE DELPHI3_LVL}
  {$DEFINE DELPHI4_LVL}
  {$DEFINE DELPHI5_LVL}
  {$DEFINE DELPHI6_LVL}
  {$DEFINE DELPHI7_LVL}
  {$DEFINE DELPHI9_LVL}
  {$DEFINE DELPHI2006_LVL}
  {$DEFINE DELPHI2007_LVL}
  {$DEFINE DELPHI2010_LVL}
  {$DEFINE DELPHIXE_LVL}
  {$DEFINE DELPHIXE2_LVL}
  {$DEFINE DELPHI_TOUCH}
  {$DEFINE DELPHI_UNICODE}
  {$IFNDEF BCB}
    {$DEFINE ISDELPHI}
  {$ENDIF}
{$ENDIF}

{$IFDEF VER240}
  {$DEFINE DELPHI2_LVL}
  {$DEFINE DELPHI3_LVL}
  {$DEFINE DELPHI4_LVL}
  {$DEFINE DELPHI5_LVL}
  {$DEFINE DELPHI6_LVL}
  {$DEFINE DELPHI7_LVL}
  {$DEFINE DELPHI9_LVL}
  {$DEFINE DELPHI2006_LVL}
  {$DEFINE DELPHI2007_LVL}
  {$DEFINE DELPHI2010_LVL}
  {$DEFINE DELPHIXE_LVL}
  {$DEFINE DELPHIXE2_LVL}
  {$DEFINE DELPHIXE3_LVL}
  {$DEFINE DELPHI_TOUCH}
  {$DEFINE DELPHI_UNICODE}
  {$IFNDEF BCB}
    {$DEFINE ISDELPHI}
  {$ENDIF}
{$ENDIF}

{$IFDEF VER250}
  {$DEFINE DELPHI2_LVL}
  {$DEFINE DELPHI3_LVL}
  {$DEFINE DELPHI4_LVL}
  {$DEFINE DELPHI5_LVL}
  {$DEFINE DELPHI6_LVL}
  {$DEFINE DELPHI7_LVL}
  {$DEFINE DELPHI9_LVL}
  {$DEFINE DELPHI2006_LVL}
  {$DEFINE DELPHI2007_LVL}
  {$DEFINE DELPHI2010_LVL}
  {$DEFINE DELPHIXE_LVL}
  {$DEFINE DELPHIXE2_LVL}
  {$DEFINE DELPHIXE3_LVL}
  {$DEFINE DELPHIXE4_LVL}
  {$DEFINE DELPHI_TOUCH}
  {$DEFINE DELPHI_UNICODE}
  {$IFNDEF BCB}
    {$DEFINE ISDELPHI}
  {$ENDIF}
{$ENDIF}

{$IFDEF VER260}
  {$DEFINE DELPHI2_LVL}
  {$DEFINE DELPHI3_LVL}
  {$DEFINE DELPHI4_LVL}
  {$DEFINE DELPHI5_LVL}
  {$DEFINE DELPHI6_LVL}
  {$DEFINE DELPHI7_LVL}
  {$DEFINE DELPHI9_LVL}
  {$DEFINE DELPHI2006_LVL}
  {$DEFINE DELPHI2007_LVL}
  {$DEFINE DELPHI2010_LVL}
  {$DEFINE DELPHIXE_LVL}
  {$DEFINE DELPHIXE2_LVL}
  {$DEFINE DELPHIXE3_LVL}
  {$DEFINE DELPHIXE4_LVL}
  {$DEFINE DELPHIXE5_LVL}
  {$DEFINE DELPHI_TOUCH}
  {$DEFINE DELPHI_UNICODE}
  {$IFNDEF BCB}
    {$DEFINE ISDELPHI}
  {$ENDIF}
{$ENDIF}

{$IFDEF VER270}
  {$DEFINE DELPHI2_LVL}
  {$DEFINE DELPHI3_LVL}
  {$DEFINE DELPHI4_LVL}
  {$DEFINE DELPHI5_LVL}
  {$DEFINE DELPHI6_LVL}
  {$DEFINE DELPHI7_LVL}
  {$DEFINE DELPHI9_LVL}
  {$DEFINE DELPHI2006_LVL}
  {$DEFINE DELPHI2007_LVL}
  {$DEFINE DELPHI2010_LVL}
  {$DEFINE DELPHIXE_LVL}
  {$DEFINE DELPHIXE2_LVL}
  {$DEFINE DELPHIXE3_LVL}
  {$DEFINE DELPHIXE4_LVL}
  {$DEFINE DELPHIXE5_LVL}
  {$DEFINE DELPHIXE6_LVL}
  {$DEFINE DELPHI_TOUCH}
  {$DEFINE DELPHI_UNICODE}
  {$IFNDEF BCB}
    {$DEFINE ISDELPHI}
  {$ENDIF}
{$ENDIF}

{$IFDEF VER280}
  {$DEFINE DELPHI2_LVL}
  {$DEFINE DELPHI3_LVL}
  {$DEFINE DELPHI4_LVL}
  {$DEFINE DELPHI5_LVL}
  {$DEFINE DELPHI6_LVL}
  {$DEFINE DELPHI7_LVL}
  {$DEFINE DELPHI9_LVL}
  {$DEFINE DELPHI2006_LVL}
  {$DEFINE DELPHI2007_LVL}
  {$DEFINE DELPHI2010_LVL}
  {$DEFINE DELPHIXE_LVL}
  {$DEFINE DELPHIXE2_LVL}
  {$DEFINE DELPHIXE3_LVL}
  {$DEFINE DELPHIXE4_LVL}
  {$DEFINE DELPHIXE5_LVL}
  {$DEFINE DELPHIXE6_LVL}
  {$DEFINE DELPHIXE7_LVL}
  {$DEFINE DELPHI_TOUCH}
  {$DEFINE DELPHI_UNICODE}
  {$IFNDEF BCB}
    {$DEFINE ISDELPHI}
  {$ENDIF}
{$ENDIF}


{$IFDEF VER290}
  {$DEFINE DELPHI2_LVL}
  {$DEFINE DELPHI3_LVL}
  {$DEFINE DELPHI4_LVL}
  {$DEFINE DELPHI5_LVL}
  {$DEFINE DELPHI6_LVL}
  {$DEFINE DELPHI7_LVL}
  {$DEFINE DELPHI9_LVL}
  {$DEFINE DELPHI2006_LVL}
  {$DEFINE DELPHI2007_LVL}
  {$DEFINE DELPHI2010_LVL}
  {$DEFINE DELPHIXE_LVL}
  {$DEFINE DELPHIXE2_LVL}
  {$DEFINE DELPHIXE3_LVL}
  {$DEFINE DELPHIXE4_LVL}
  {$DEFINE DELPHIXE5_LVL}
  {$DEFINE DELPHIXE6_LVL}
  {$DEFINE DELPHIXE7_LVL}
  {$DEFINE DELPHIXE8_LVL}
  {$DEFINE DELPHI_TOUCH}
  {$DEFINE DELPHI_UNICODE}
  {$IFNDEF BCB}
    {$DEFINE ISDELPHI}
  {$ENDIF}
{$ENDIF}


{$IFDEF VER300}
  {$DEFINE DELPHI2_LVL}
  {$DEFINE DELPHI3_LVL}
  {$DEFINE DELPHI4_LVL}
  {$DEFINE DELPHI5_LVL}
  {$DEFINE DELPHI6_LVL}
  {$DEFINE DELPHI7_LVL}
  {$DEFINE DELPHI9_LVL}
  {$DEFINE DELPHI2006_LVL}
  {$DEFINE DELPHI2007_LVL}
  {$DEFINE DELPHI2010_LVL}
  {$DEFINE DELPHIXE_LVL}
  {$DEFINE DELPHIXE2_LVL}
  {$DEFINE DELPHIXE3_LVL}
  {$DEFINE DELPHIXE4_LVL}
  {$DEFINE DELPHIXE5_LVL}
  {$DEFINE DELPHIXE6_LVL}
  {$DEFINE DELPHIXE7_LVL}
  {$DEFINE DELPHIXE8_LVL}
  {$DEFINE DELPHIXE9_LVL}
  {$DEFINE DELPHI_TOUCH}
  {$DEFINE DELPHI_UNICODE}
  {$DEFINE DELPHI10_LVL}
  {$IFNDEF BCB}
    {$DEFINE ISDELPHI}
  {$ENDIF}
{$ENDIF}

{$IFDEF VER310}
  {$DEFINE DELPHI2_LVL}
  {$DEFINE DELPHI3_LVL}
  {$DEFINE DELPHI4_LVL}
  {$DEFINE DELPHI5_LVL}
  {$DEFINE DELPHI6_LVL}
  {$DEFINE DELPHI7_LVL}
  {$DEFINE DELPHI9_LVL}
  {$DEFINE DELPHI2006_LVL}
  {$DEFINE DELPHI2007_LVL}
  {$DEFINE DELPHI2010_LVL}
  {$DEFINE DELPHIXE_LVL}
  {$DEFINE DELPHIXE2_LVL}
  {$DEFINE DELPHIXE3_LVL}
  {$DEFINE DELPHIXE4_LVL}
  {$DEFINE DELPHIXE5_LVL}
  {$DEFINE DELPHIXE6_LVL}
  {$DEFINE DELPHIXE7_LVL}
  {$DEFINE DELPHIXE8_LVL}
  {$DEFINE DELPHIXE9_LVL}
  {$DEFINE DELPHIXE10_LVL}
  {$DEFINE DELPHIXE10_1_LVL}
  {$DEFINE DELPHI_TOUCH}
  {$DEFINE DELPHI_UNICODE}
  {$DEFINE DELPHI10_LVL}
  {$IFNDEF BCB}
    {$DEFINE ISDELPHI}
  {$ENDIF}
{$ENDIF}

{$IFDEF VER320}
  {$DEFINE DELPHI2_LVL}
  {$DEFINE DELPHI3_LVL}
  {$DEFINE DELPHI4_LVL}
  {$DEFINE DELPHI5_LVL}
  {$DEFINE DELPHI6_LVL}
  {$DEFINE DELPHI7_LVL}
  {$DEFINE DELPHI9_LVL}
  {$DEFINE DELPHI2006_LVL}
  {$DEFINE DELPHI2007_LVL}
  {$DEFINE DELPHI2010_LVL}
  {$DEFINE DELPHIXE_LVL}
  {$DEFINE DELPHIXE2_LVL}
  {$DEFINE DELPHIXE3_LVL}
  {$DEFINE DELPHIXE4_LVL}
  {$DEFINE DELPHIXE5_LVL}
  {$DEFINE DELPHIXE6_LVL}
  {$DEFINE DELPHIXE7_LVL}
  {$DEFINE DELPHIXE8_LVL}
  {$DEFINE DELPHIXE9_LVL}
  {$DEFINE DELPHIXE10_LVL}
  {$DEFINE DELPHIXE10_1_LVL}
  {$DEFINE DELPHIXE10_2_LVL}
  {$DEFINE DELPHI_TOUCH}
  {$DEFINE DELPHI_UNICODE}
  {$DEFINE DELPHI10_LVL}
  {$IFNDEF BCB}
    {$DEFINE ISDELPHI}
  {$ENDIF}
{$ENDIF}

{$IFDEF IOS}
  {$DEFINE DELPHI_LLVM}
{$ENDIF}

{$IFDEF ANDROID}
  {$DEFINE DELPHI_LLVM}
{$ENDIF}

{$IFDEF VER110}
 {$ObjExportAll On}
{$ENDIF}

{$IFDEF VER125}
 {$ObjExportAll On}
{$ENDIF}

{$IFDEF VER130}
 {$IFDEF BCB}
  {$ObjExportAll On}
 {$ELSE}
  {$DEFINE ISDELPHI}
 {$ENDIF}
{$ENDIF}

{$IFDEF ISDELPHI}
 {$IFDEF DELPHI3_LVL}
  {$DEFINE DELPHI_ONLY_LVL3}
 {$ENDIF}
{$ENDIF}

{$IFDEF DELPHI7_LVL}
{$WARN UNIT_PLATFORM OFF}
{$WARN SYMBOL_PLATFORM OFF}
{$ENDIF}

     
       
            
          
         
     
         
 
