{$DEFINE RESTDW}
{$DEFINE COMPILELAZ}

{$IFNDEF FPC}
  {$IF CompilerVersion > 23}
    {$LEGACYIFEND ON}
  {$IFEND}
 {$IF Defined(ANDROID) or Defined(IOS)}
  {$DEFINE MOBILE}
 {$IFEND}
{$ENDIF}

{$IFDEF CLR}
  {$DEFINE RESTDWDELPHINET}
{$ENDIF}

{$IFDEF COMPILELAZ}
 {$IFDEF FPC}
  {$DEFINE RESTDWLAZARUS}
  {$IFDEF LAMW}
    {$DEFINE RESTDWLAMW}
  {$ENDIF}
 {$ENDIF}
{$ENDIF}

{$IFNDEF FPC}
 {$IFDEF VER360 or CompilerVersion >= 36}
  {$DEFINE DELPHI12UP}
  {$DEFINE DELPHI11UP}
  {$DEFINE DELPHI10_4UP}
  {$DEFINE DELPHI10_3UP}
  {$DEFINE DELPHI10_2UP}
  {$DEFINE DELPHI10_1UP}
  {$DEFINE DELPHI10_0UP}
  {$DEFINE DELPHIXE8UP}
  {$DEFINE DELPHIXE7UP}
  {$DEFINE DELPHIXE6UP}
  {$DEFINE DELPHIXE5UP}
  {$DEFINE DELPHIXE4UP}
  {$DEFINE DELPHIXE3UP}
  {$DEFINE DELPHIXE2UP}
  {$DEFINE DELPHIXEUP}
  {$DEFINE DELPHI2010UP}
  {$DEFINE DELPHI2009UP}
  {$DEFINE DELPHI2007UP}
  {$DEFINE DELPHI2006UP}
  {$DEFINE DELPHI2005UP}
  {$DEFINE DELPHI8UP}
  {$DEFINE DELPHI7UP}
  {$DEFINE RTL280_UP}
 {$ENDIF ~VER360}
 {$IFDEF VER350 or CompilerVersion >= 35}
  {$DEFINE DELPHI11UP}
  {$DEFINE DELPHI10_4UP}
  {$DEFINE DELPHI10_3UP}
  {$DEFINE DELPHI10_2UP}
  {$DEFINE DELPHI10_1UP}
  {$DEFINE DELPHI10_0UP}
  {$DEFINE DELPHIXE8UP}
  {$DEFINE DELPHIXE7UP}
  {$DEFINE DELPHIXE6UP}
  {$DEFINE DELPHIXE5UP}
  {$DEFINE DELPHIXE4UP}
  {$DEFINE DELPHIXE3UP}
  {$DEFINE DELPHIXE2UP}
  {$DEFINE DELPHIXEUP}
  {$DEFINE DELPHI2010UP}
  {$DEFINE DELPHI2009UP}
  {$DEFINE DELPHI2007UP}
  {$DEFINE DELPHI2006UP}
  {$DEFINE DELPHI2005UP}
  {$DEFINE DELPHI8UP}
  {$DEFINE DELPHI7UP}
  {$DEFINE RTL280_UP}
 {$ENDIF ~VER350}

 {$IFDEF VER340 or CompilerVersion >= 34}
  {$DEFINE DELPHI10_4UP}
  {$DEFINE DELPHI10_3UP}
  {$DEFINE DELPHI10_2UP}
  {$DEFINE DELPHI10_1UP}
  {$DEFINE DELPHI10_0UP}
  {$DEFINE DELPHIXE8UP}
  {$DEFINE DELPHIXE7UP}
  {$DEFINE DELPHIXE6UP}
  {$DEFINE DELPHIXE5UP}
  {$DEFINE DELPHIXE4UP}
  {$DEFINE DELPHIXE3UP}
  {$DEFINE DELPHIXE2UP}
  {$DEFINE DELPHIXEUP}
  {$DEFINE DELPHI2010UP}
  {$DEFINE DELPHI2009UP}
  {$DEFINE DELPHI2007UP}
  {$DEFINE DELPHI2006UP}
  {$DEFINE DELPHI2005UP}
  {$DEFINE DELPHI8UP}
  {$DEFINE DELPHI7UP}
  {$DEFINE RTL280_UP}
 {$ENDIF ~VER340}

 {$IFDEF VER330 or CompilerVersion >= 33}
  {$DEFINE DELPHI10_3UP}
  {$DEFINE DELPHI10_2UP}
  {$DEFINE DELPHI10_1UP}
  {$DEFINE DELPHI10_0UP}
  {$DEFINE DELPHIXE8UP}
  {$DEFINE DELPHIXE7UP}
  {$DEFINE DELPHIXE6UP}
  {$DEFINE DELPHIXE5UP}
  {$DEFINE DELPHIXE4UP}
  {$DEFINE DELPHIXE3UP}
  {$DEFINE DELPHIXE2UP}
  {$DEFINE DELPHIXEUP}
  {$DEFINE DELPHI2010UP}
  {$DEFINE DELPHI2009UP}
  {$DEFINE DELPHI2007UP}
  {$DEFINE DELPHI2006UP}
  {$DEFINE DELPHI2005UP}
  {$DEFINE DELPHI8UP}
  {$DEFINE DELPHI7UP}
  {$DEFINE RTL280_UP}
 {$ENDIF ~VER330}

 {$IFDEF VER320 or CompilerVersion >= 32}
  {$DEFINE DELPHI10_2UP}
  {$DEFINE DELPHI10_1UP}
  {$DEFINE DELPHI10_0UP}
  {$DEFINE DELPHIXE8UP}
  {$DEFINE DELPHIXE7UP}
  {$DEFINE DELPHIXE6UP}
  {$DEFINE DELPHIXE5UP}
  {$DEFINE DELPHIXE4UP}
  {$DEFINE DELPHIXE3UP}
  {$DEFINE DELPHIXE2UP}
  {$DEFINE DELPHIXEUP}
  {$DEFINE DELPHI2010UP}
  {$DEFINE DELPHI2009UP}
  {$DEFINE DELPHI2007UP}
  {$DEFINE DELPHI2006UP}
  {$DEFINE DELPHI2005UP}
  {$DEFINE DELPHI8UP}
  {$DEFINE DELPHI7UP}
  {$DEFINE RTL280_UP}
 {$ENDIF ~VER320}

 {$IFDEF VER310 or CompilerVersion >= 31}
  {$DEFINE DELPHI10_1UP}
  {$DEFINE DELPHI10_0UP}
  {$DEFINE DELPHIXE8UP}
  {$DEFINE DELPHIXE7UP}
  {$DEFINE DELPHIXE6UP}
  {$DEFINE DELPHIXE5UP}
  {$DEFINE DELPHIXE4UP}
  {$DEFINE DELPHIXE3UP}
  {$DEFINE DELPHIXE2UP}
  {$DEFINE DELPHIXEUP}
  {$DEFINE DELPHI2010UP}
  {$DEFINE DELPHI2009UP}
  {$DEFINE DELPHI2007UP}
  {$DEFINE DELPHI2006UP}
  {$DEFINE DELPHI2005UP}
  {$DEFINE DELPHI8UP}
  {$DEFINE DELPHI7UP}
  {$DEFINE RTL280_UP}
 {$ENDIF ~VER310}

{$IFDEF VER300 or CompilerVersion >= 30}
  {$DEFINE DELPHI10_0UP}
  {$DEFINE DELPHIXE8UP}
  {$DEFINE DELPHIXE7UP}
  {$DEFINE DELPHIXE6UP}
  {$DEFINE DELPHIXE5UP}
  {$DEFINE DELPHIXE4UP}
  {$DEFINE DELPHIXE3UP}
  {$DEFINE DELPHIXE2UP}
  {$DEFINE DELPHIXEUP}
  {$DEFINE DELPHI2010UP}
  {$DEFINE DELPHI2009UP}
  {$DEFINE DELPHI2007UP}
  {$DEFINE DELPHI2006UP}
  {$DEFINE DELPHI2005UP}
  {$DEFINE DELPHI8UP}
  {$DEFINE DELPHI7UP}
  {$DEFINE RTL280_UP}
 {$ENDIF ~VER300}

 {$IFDEF VER290 or CompilerVersion >= 29}
  {$DEFINE DELPHIXE8UP}
  {$DEFINE DELPHIXE7UP}
  {$DEFINE DELPHIXE6UP}
  {$DEFINE DELPHIXE5UP}
  {$DEFINE DELPHIXE4UP}
  {$DEFINE DELPHIXE3UP}
  {$DEFINE DELPHIXE2UP}
  {$DEFINE DELPHIXEUP}
  {$DEFINE DELPHI2010UP}
  {$DEFINE DELPHI2009UP}
  {$DEFINE DELPHI2007UP}
  {$DEFINE DELPHI2006UP}
  {$DEFINE DELPHI2005UP}
  {$DEFINE DELPHI8UP}
  {$DEFINE DELPHI7UP}
  {$DEFINE RTL280_UP}
 {$ENDIF ~VER290}

 {$IFDEF VER280 or CompilerVersion >= 28}
  {$DEFINE DELPHIXE7UP}
  {$DEFINE DELPHIXE6UP}
  {$DEFINE DELPHIXE5UP}
  {$DEFINE DELPHIXE4UP}
  {$DEFINE DELPHIXE3UP}
  {$DEFINE DELPHIXE2UP}
  {$DEFINE DELPHIXEUP}
  {$DEFINE DELPHI2010UP}
  {$DEFINE DELPHI2009UP}
  {$DEFINE DELPHI2007UP}
  {$DEFINE DELPHI2006UP}
  {$DEFINE DELPHI2005UP}
  {$DEFINE DELPHI8UP}
  {$DEFINE DELPHI7UP}
  {$DEFINE RTL280_UP}
{$ENDIF ~VER280}

{$IFDEF VER270 or CompilerVersion >= 27}
  {$DEFINE DELPHIXE6UP}
  {$DEFINE DELPHIXE5UP}
  {$DEFINE DELPHIXE4UP}
  {$DEFINE DELPHIXE3UP}
  {$DEFINE DELPHIXE2UP}
  {$DEFINE DELPHIXEUP}
  {$DEFINE DELPHI2010UP}
  {$DEFINE DELPHI2009UP}
  {$DEFINE DELPHI2007UP}
  {$DEFINE DELPHI2006UP}
  {$DEFINE DELPHI2005UP}
  {$DEFINE DELPHI8UP}
  {$DEFINE DELPHI7UP}
  {$DEFINE RTL270_UP}
 {$ENDIF ~VER270}

 {$IFDEF VER260 or CompilerVersion >= 26}
  {$DEFINE DELPHIXE5UP}
  {$DEFINE DELPHIXE4UP}
  {$DEFINE DELPHIXE3UP}
  {$DEFINE DELPHIXE2UP}
  {$DEFINE DELPHIXEUP}
  {$DEFINE DELPHI2010UP}
  {$DEFINE DELPHI2009UP}
  {$DEFINE DELPHI2007UP}
  {$DEFINE DELPHI2006UP}
  {$DEFINE DELPHI2005UP}
  {$DEFINE DELPHI8UP}
  {$DEFINE DELPHI7UP}
  {$DEFINE RTL260_UP}
 {$ENDIF ~VER260}

 {$IFDEF VER250 or CompilerVersion >= 25}
  {$DEFINE DELPHIXE4UP}
  {$DEFINE DELPHIXE3UP}
  {$DEFINE DELPHIXE2UP}
  {$DEFINE DELPHIXEUP}
  {$DEFINE DELPHI2010UP}
  {$DEFINE DELPHI2009UP}
  {$DEFINE DELPHI2007UP}
  {$DEFINE DELPHI2006UP}
  {$DEFINE DELPHI2005UP}
  {$DEFINE DELPHI8UP}
  {$DEFINE DELPHI7UP}
  {$DEFINE RTL250_UP}
 {$ENDIF ~VER250}

 {$IFDEF VER240 or CompilerVersion >= 24}
  {$DEFINE DELPHIXE3UP}
  {$DEFINE DELPHIXE2UP}
  {$DEFINE DELPHIXEUP}
  {$DEFINE DELPHI2010UP}
  {$DEFINE DELPHI2009UP}
  {$DEFINE DELPHI2007UP}
  {$DEFINE DELPHI2006UP}
  {$DEFINE DELPHI2005UP}
  {$DEFINE DELPHI8UP}
  {$DEFINE DELPHI7UP}
  {$DEFINE RTL240_UP}
 {$ENDIF ~VER240}

 {$IFDEF VER230 or CompilerVersion >= 23}
  {$DEFINE DELPHIXE2UP}
  {$DEFINE DELPHIXEUP}
  {$DEFINE DELPHI2010UP}
  {$DEFINE DELPHI2009UP}
  {$DEFINE DELPHI2007UP}
  {$DEFINE DELPHI2006UP}
  {$DEFINE DELPHI2005UP}
  {$DEFINE DELPHI8UP}
  {$DEFINE DELPHI7UP}
  {$DEFINE RTL230_UP}
 {$ENDIF ~VER230}

 {$IFDEF VER220 or CompilerVersion >= 22}
  {$DEFINE DELPHIXEUP}
  {$DEFINE DELPHI2010UP}
  {$DEFINE DELPHI2009UP}
  {$DEFINE DELPHI2007UP}
  {$DEFINE DELPHI2006UP}
  {$DEFINE DELPHI2005UP}
  {$DEFINE DELPHI8UP}
  {$DEFINE DELPHI7UP}
  {$DEFINE RTL220_UP}
 {$ENDIF ~VER220}

 {$IFDEF VER210 or CompilerVersion >= 21}
  {$DEFINE DELPHI2010UP}
  {$DEFINE DELPHI2009UP}
  {$DEFINE DELPHI2007UP}
  {$DEFINE DELPHI2006UP}
  {$DEFINE DELPHI2005UP}
  {$DEFINE DELPHI8UP}
  {$DEFINE DELPHI7UP}
  {$DEFINE RTL210_UP}
 {$ENDIF ~VER210}

 {$IFDEF VER200 or CompilerVersion >= 20}
  {$DEFINE DELPHI2009UP}
  {$DEFINE DELPHI2007UP}
  {$DEFINE DELPHI2006UP}
  {$DEFINE DELPHI2005UP}
  {$DEFINE DELPHI8UP}
  {$DEFINE DELPHI7UP}
  {$IFDEF CLR}
        {$DEFINE CLR20}
  {$ENDIF CLR}
  {$IFDEF CLR}
    {$DEFINE RTL190_UP}
  {$ELSE}
    {$DEFINE RTL200_UP}
  {$ENDIF}
 {$ENDIF ~VER200}

 {$IFDEF VER190 or CompilerVersion >= 19}
  {$DEFINE DELPHI2007UP}
  {$DEFINE DELPHI2006UP}
  {$DEFINE DELPHI2005UP}
  {$DEFINE DELPHI8UP}
  {$DEFINE DELPHI7UP}
  {$IFDEF CLR}
        {$DEFINE CLR20}
      {$ENDIF CLR}
  {$DEFINE RTL190_UP}
 {$ENDIF ~VER190}

 {$IFDEF VER180 OR VER185 or CompilerVersion >= 18}
  {$DEFINE DELPHI2006UP}
  {$DEFINE DELPHI2005UP}
  {$DEFINE DELPHI8UP}
  {$DEFINE DELPHI7UP}
  {$IFDEF CLR}
    {$DEFINE CLR11}
   {$ENDIF CLR}
  {$DEFINE RTL180_UP}
 {$ENDIF ~VER180 OR VER185}

 {$IFDEF VER170 or CompilerVersion >= 17}
  {$DEFINE DELPHI2005UP}
  {$DEFINE DELPHI8UP}
  {$DEFINE DELPHI7UP}
  {$IFDEF CLR}
        {$DEFINE CLR11}
      {$ENDIF CLR}
  {$DEFINE RTL170_UP}
 {$ENDIF ~VER170}

 {$IFDEF VER160 or CompilerVersion >= 16}
  {$DEFINE DELPHI8UP}
  {$DEFINE DELPHI7UP}
  {$DEFINE RTL160_UP}
  {$IFDEF CLR}
        {$DEFINE CLR10}
  {$ENDIF CLR}
 {$ENDIF ~VER160}

 {$IFDEF VER150 or CompilerVersion >= 15}
  {$DEFINE DELPHI7UP}
  {$DEFINE RTL150_UP}
 {$ENDIF ~VER150}

    {$IFDEF VER80}
      {$DEFINE COMPILER1}
      {$DEFINE DELPHI1}
      {$DEFINE DELPHICOMPILER1}
      {$DEFINE RTL80_UP}
      {$UNDEF UNKNOWN_COMPILER_VERSION}
    {$ENDIF}

    {$IFDEF VER90}
      {$DEFINE COMPILER2}
      {$DEFINE DELPHI2}
      {$DEFINE DELPHICOMPILER2}
      {$DEFINE RTL90_UP}
      {$UNDEF UNKNOWN_COMPILER_VERSION}
    {$ENDIF}

    {$IFDEF VER93}
      {$DEFINE COMPILER2}
      {$DEFINE BCB1}
      {$DEFINE BCB}
      {$DEFINE RTL93_UP}
      {$UNDEF UNKNOWN_COMPILER_VERSION}
    {$ENDIF}

    {$IFDEF VER100}
      {$DEFINE COMPILER3}
      {$DEFINE DELPHI3}
      {$DEFINE DELPHICOMPILER3}
      {$DEFINE RTL100_UP}
      {$UNDEF UNKNOWN_COMPILER_VERSION}
    {$ENDIF}

    {$IFDEF VER110}
      {$DEFINE COMPILER35}
      {$DEFINE BCB3}
      {$DEFINE BCB}
      {$DEFINE RTL110_UP}
      {$UNDEF UNKNOWN_COMPILER_VERSION}
    {$ENDIF}

    {$IFDEF VER120}
      {$DEFINE COMPILER4}
      {$DEFINE DELPHI4}
      {$DEFINE DELPHICOMPILER4}
      {$DEFINE RTL120_UP}
      {$UNDEF UNKNOWN_COMPILER_VERSION}
    {$ENDIF}

    {$IFDEF VER125}
      {$DEFINE COMPILER4}
      {$DEFINE BCB4}
      {$DEFINE BCB}
      {$DEFINE RTL125_UP}
      {$UNDEF UNKNOWN_COMPILER_VERSION}
    {$ENDIF}

    {$IFDEF VER130}
      {$DEFINE COMPILER5}
      {$IFDEF BCB}
        {$DEFINE BCB5}
      {$ELSE}
        {$DEFINE DELPHI5}
        {$DEFINE DELPHICOMPILER5}
      {$ENDIF}
      {$DEFINE RTL130_UP}
      {$UNDEF UNKNOWN_COMPILER_VERSION}
    {$ENDIF}

    {$IFDEF VER140}
      {$DEFINE COMPILER6}
      {$IFDEF BCB}
        {$DEFINE BCB6}
      {$ELSE}
        {$DEFINE DELPHI6}
        {$DEFINE DELPHICOMPILER6}
      {$ENDIF}
      {$DEFINE RTL140_UP}
      {$UNDEF UNKNOWN_COMPILER_VERSION}
    {$ENDIF}
{$ENDIF}

{------------------------------------------------------------------------------}
{ RTLX_UP from RTLX_UP mappings                                                }
{------------------------------------------------------------------------------}

{$IFDEF RTL280_UP} {$DEFINE RTL270_UP} {$ENDIF}
{$IFDEF RTL270_UP} {$DEFINE RTL260_UP} {$ENDIF}
{$IFDEF RTL260_UP} {$DEFINE RTL250_UP} {$ENDIF}
{$IFDEF RTL250_UP} {$DEFINE RTL240_UP} {$ENDIF}
{$IFDEF RTL240_UP} {$DEFINE RTL230_UP} {$ENDIF}
{$IFDEF RTL230_UP} {$DEFINE RTL220_UP} {$ENDIF}
{$IFDEF RTL220_UP} {$DEFINE RTL210_UP} {$ENDIF}
{$IFDEF RTL210_UP} {$DEFINE RTL200_UP} {$ENDIF}
{$IFDEF RTL200_UP} {$DEFINE RTL190_UP} {$ENDIF}
{$IFDEF RTL190_UP} {$DEFINE RTL185_UP} {$ENDIF}
{$IFDEF RTL185_UP} {$DEFINE RTL180_UP} {$ENDIF}
{$IFDEF RTL180_UP} {$DEFINE RTL170_UP} {$ENDIF}
{$IFDEF RTL170_UP} {$DEFINE RTL160_UP} {$ENDIF}
{$IFDEF RTL160_UP} {$DEFINE RTL150_UP} {$ENDIF}
{$IFDEF RTL150_UP} {$DEFINE RTL145_UP} {$ENDIF}
{$IFDEF RTL145_UP} {$DEFINE RTL142_UP} {$ENDIF}
{$IFDEF RTL142_UP} {$DEFINE RTL140_UP} {$ENDIF}
{$IFDEF RTL140_UP} {$DEFINE RTL130_UP} {$ENDIF}
{$IFDEF RTL130_UP} {$DEFINE RTL125_UP} {$ENDIF}
{$IFDEF RTL125_UP} {$DEFINE RTL120_UP} {$ENDIF}
{$IFDEF RTL120_UP} {$DEFINE RTL110_UP} {$ENDIF}
{$IFDEF RTL110_UP} {$DEFINE RTL100_UP} {$ENDIF}
{$IFDEF RTL100_UP} {$DEFINE RTL93_UP}  {$ENDIF}
{$IFDEF RTL93_UP}  {$DEFINE RTL90_UP}  {$ENDIF}
{$IFDEF RTL90_UP}  {$DEFINE RTL80_UP}  {$ENDIF}	


{$IFNDEF FPC}
  {$IFDEF DELPHIXE5UP}
   {$IF Declared(FireMonkeyVersion) or Defined(FRAMEWORK_FMX)
        Declared(FMX.Types.TFmxObject) or Defined(LINUX64)}
     {$DEFINE HAS_FMX}
     {$DEFINE RESTDWFMX}
   {$ELSE}
    {$DEFINE RESTDWVCL}
   {$IFEND}
  {$ELSE}
   {$DEFINE RESTDWVCL}
  {$ENDIF}
{$ENDIF}


(* End of FRAMEWORK Directives *)
(******************************************************************************)
(*  OS Architecture Directives *)

{$IF Defined(IOS) or Defined(IOS64) or Defined(DCCIOS32) or Defined(MACOS) or
  Defined(MACOS32)}
  {$DEFINE RESTDWAPPLE}
  {$DEFINE HAS_UTF8}
  {$DEFINE RESTDWUTF8}
  {$UNDEF RESTDWVCL}
{$IFEND}

{$IF Defined(ANDROID) or Defined(Android64)}
  {$DEFINE RESTDWANDROID}
  {$DEFINE HAS_UTF8}
  {$DEFINE RESTDWUTF8}
  {$DEFINE HAS_FMX}
  {$DEFINE RESTDWFMX}
  {$UNDEF RESTDWVCL}
{$IFEND}

{$IF Defined(LINUX) or Defined(LINUX32) or Defined(LINUX64) or Defined(UNIX)}
  {$DEFINE RESTDWLINUX}
  {$DEFINE HAS_UTF8}
  {$DEFINE RESTDWUTF8}
  {$IFDEF RESTDWFMX}
    {$DEFINE RESTDWLINUXFMX}
  {$ENDIF}
{$IFEND}

{$IF Defined(MSWINDOWS) or Defined(WIN32) or Defined(WIN64) or Defined(WINDOWS)}
  {$DEFINE RESTDWWINDOWS}
  {$IFDEF RESTDWFMX}
    {$DEFINE RESTDWWINFMX}
  {$ENDIF}
{$IFEND}

{$IF Defined(POSIX)}
  {$DEFINE RESTDWAPPLE}
  {$DEFINE RESTDWLINUX}
{$IFEND}

{$IF Defined(NEXTGEN)}
  {$DEFINE RESTDWANDROID}
  {$DEFINE RESTDWAPPLE}
{$IFEND}

{$IF (Defined(IOS) or Defined(RESTDWANDROID)) AND Defined(RESTDWFMX)}
  {$DEFINE RESTDWMOBILE}
{$IFEND}

(* End of OS Architecture Directives *)
(******************************************************************************)
(* GUI Directives *)

{$IF Defined(CONSOLE) or Defined(FRAMEWORK) or Defined(LCL) or Defined(LAMW)}
  {$DEFINE NOGUI}
{$IFEND}

(* End of GUI Directives *)
(* Delphi Bug avoidance Directives*)

{$IFDEF DELPHIXE8UP}
  {$DEFINE NOTRAWSUPPORT}
{$ENDIF}

(* End of Delphi Bug avoidance Directives*)
(******************************************************************************)
(* General functional Directives *)

{.$DEFINE RESTDWDEBUG}

{$IFDEF RESTDWDEBUG}
  {$IFDEF DELPHI2010UP}
    {$WARN IMPLICIT_STRING_CAST OFF}
    {$WARN IMPLICIT_STRING_CAST_LOSS OFF}
  {$ENDIF}
  {$IFDEF DELPHI7UP}
    {$WARN DUPLICATE_CTOR_DTOR OFF}
    {.$WARN CVT_ACHAR_TO_WCHAR OFF}
  {$ENDIF}
  {$WARN SYMBOL_PLATFORM OFF}
  {$WARN SYMBOL_DEPRECATED OFF}
  {$WARN USE_BEFORE_DEF OFF}
  {$WARNINGS OFF}
  {$HINTS OFF}
{$ENDIF}

{$IFDEF DELPHI2010UP}
  {$DEFINE SUPPORTS_UNICODE_STRING}
  {$POINTERMATH ON}
{$ENDIF}

{$IFNDEF NEXTGEN}
  {$DEFINE HAS_AnsiString}
  {$DEFINE STRING_IS_ANSI}
{$ENDIF}

{$IF Defined(DELPHICOMPILER) or Defined(BCBCOMPILER)}
  {$DEFINE DELPHILANGUAGE}
{$IFEND}

(* End of General functional Directives *)
(******************************************************************************)
(* CPU Architecture Directives *)

{$IFDEF RESTDWLAZARUS}
  {$DEFINE CPUASM} // FPC defines CPU32, CPU64 and Unix automatically
{$ELSE}
  {$IF Defined(CPUX64) or Defined(CPU64BITS) or Defined(CPUARM64)}
    {$DEFINE CPU64}
    {$DEFINE CPUASM}
    {$DEFINE DELPHI64_TEMPORARY}
  {$ELSE}
    {$DEFINE CPU386} // For Borland compilers select the x86 compat assembler by default
    {$DEFINE CPU32}  // Assume Borland compilers are 32-bit (rather than 64-bit)
    {$DEFINE CPUASM}
  {$IFEND}
{$ENDIF}

(* End of CPU Architecture Directives *)
(******************************************************************************)
(* Lazarus/FPC exclusive Directives *)

{$IFDEF FPC}
  {$IFDEF  VER1_0}
     Please use FPC 2.0 or higher to compile this.
  {$ELSE}
    {$DEFINE SUPPORTS_OUTPARAMS}
    {$DEFINE SUPPORTS_WIDECHAR}
    {$DEFINE SUPPORTS_WIDESTRING}
    {$IFDEF HASINTF}
      {$DEFINE SUPPORTS_INTERFACE}
    {$ENDIF}
    {$IFDEF HASVARIANT}
      {$DEFINE SUPPORTS_VARIANT}
    {$ENDIF}
    {$IFDEF FPC_HAS_TYPE_SINGLE}
      {$DEFINE SUPPORTS_SINGLE}
    {$ENDIF}
    {$IFDEF FPC_HAS_TYPE_DOUBLE}
      {$DEFINE SUPPORTS_DOUBLE}
    {$ENDIF}
    {$IFDEF FPC_HAS_TYPE_EXTENDED}
      {$DEFINE SUPPORTS_EXTENDED}
    {$ENDIF}
    {$IFDEF HASCURRENCY}
      {$DEFINE SUPPORTS_CURRENCY}
    {$ENDIF}
    {$DEFINE SUPPORTS_THREADVAR}
    {$DEFINE SUPPORTS_CONSTPARAMS}
    {$DEFINE SUPPORTS_LONGWORD}
    {$DEFINE SUPPORTS_INT64}
    {$DEFINE SUPPORTS_DYNAMICARRAYS}
    {$DEFINE SUPPORTS_DEFAULTPARAMS}
    {$DEFINE SUPPORTS_OVERLOAD}
    {$DEFINE ACCEPT_DEPRECATED}  // 2.2 also gives warnings
    {$DEFINE ACCEPT_PLATFORM}    // 2.2 also gives warnings
    {$DEFINE ACCEPT_LIBRARY}
    {$DEFINE SUPPORTS_EXTSYM}
    {$DEFINE SUPPORTS_NODEFINE}
    {$DEFINE SUPPORTS_CUSTOMVARIANTS}
    {$DEFINE SUPPORTS_VARARGS}
    {$DEFINE SUPPORTS_ENUMVALUE}
    {$IFDEF LINUX}
      {$DEFINE HAS_UNIT_LIBC}
    {$ENDIF LINUX}
    {$DEFINE HAS_UNIT_CONTNRS}
    {$DEFINE HAS_UNIT_TYPES}
    {$DEFINE HAS_UNIT_VARIANTS}
    {$DEFINE HAS_UNIT_STRUTILS}
    {$DEFINE HAS_UNIT_DATEUTILS}
    {$DEFINE HAS_UNIT_RTLCONSTS}
    {$DEFINE XPLATFORM_RTL}

    {$IFDEF VER2_2}
      {$DEFINE SUPPORTS_DISPINTERFACE}
      {$DEFINE SUPPORTS_IMPLEMENTS}
      {$DEFINE SUPPORTS_DISPID}
    {$ELSE}
      {$UNDEF SUPPORTS_DISPINTERFACE}
      {$UNDEF SUPPORTS_IMPLEMENTS}
    {$endif}
    {$UNDEF SUPPORTS_UNSAFE_WARNINGS}
  {$ENDIF}
{$ENDIF FPC}

(* End of Lazarus/FPC exclusive Directives *)
(******************************************************************************)
(* Compiler settings *)

{$IFOPT A+} {$DEFINE ALIGN_ON} {$ENDIF}
{$IFOPT B+} {$DEFINE BOOLEVAL_ON} {$ENDIF}
{$IFDEF COMPILER2_UP}
  {$IFOPT C+} {$DEFINE ASSERTIONS_ON} {$ENDIF}
{$ENDIF}
{$IFOPT D+} {$DEFINE DEBUGINFO_ON} {$ENDIF}
{$IFOPT G+} {$DEFINE IMPORTEDDATA_ON} {$ENDIF}
{$IFDEF COMPILER2_UP}
  {$IFOPT H+} {$DEFINE LONGSTRINGS_ON} {$ENDIF}
{$ENDIF}

// Hints
{$IFOPT I+} {$DEFINE IOCHECKS_ON} {$ENDIF}
{$IFDEF COMPILER2_UP}
  {$IFOPT J+} {$DEFINE WRITEABLECONST_ON} {$ENDIF}
{$ENDIF}
{$IFOPT L+} {$DEFINE LOCALSYMBOLS} {$DEFINE LOCALSYMBOLS_ON} {$ENDIF}
{$IFOPT M+} {$DEFINE TYPEINFO_ON} {$ENDIF}
{$IFOPT O+} {$DEFINE OPTIMIZATION_ON} {$ENDIF}
{$IFOPT P+} {$DEFINE OPENSTRINGS_ON} {$ENDIF}
{$IFOPT Q+} {$DEFINE OVERFLOWCHECKS_ON} {$ENDIF}
{$IFOPT R+} {$DEFINE RANGECHECKS_ON} {$ENDIF}

// Real compatibility
{$IFOPT T+} {$DEFINE TYPEDADDRESS_ON} {$ENDIF}
{$IFOPT U+} {$DEFINE SAFEDIVIDE_ON} {$ENDIF}
{$IFOPT V+} {$DEFINE VARSTRINGCHECKS_ON} {$ENDIF}
{$IFOPT W+} {$DEFINE STACKFRAMES_ON} {$ENDIF}

// Warnings
{$IFOPT X+} {$DEFINE EXTENDEDSYNTAX_ON} {$ENDIF}

// for Delphi/BCB trial versions remove the point from the line below
{.$UNDEF SUPPORTS_WEAKPACKAGEUNIT}

(* End of Compiler settings *)
(* REST DataWare Generic Definitions *)

  {$DEFINE RESTDWMEMTABLE}

(* End of REST DataWare Generic Definitions *)

(******************************************************************************)
